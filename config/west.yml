## config/west.yml
```yaml
manifest:
  remotes:
    - name: zmkfirmware
      url-base: https://github.com/zmkfirmware
  projects:
    - name: zmk
      remote: zmkfirmware
      revision: a17266847dcd5e3e202ed7eb559665f22a10b86e
      import: app/west.yml
  self:
    path: config
```
